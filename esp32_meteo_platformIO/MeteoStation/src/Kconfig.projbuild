## esp32_meteo_platformIO/MeteoStation/src/Kconfig.projbuild
```kconfig
menu "WiFi Configuration"
    config WIFI_SSID
        string "WiFi SSID"
        default "Ukrtelecom_EB36"
    config WIFI_PASSWORD
        string "WiFi Password"
        default "55011471"
endmenu
```
